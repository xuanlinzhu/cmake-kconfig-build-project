## ck_tools/template/Kconfig
```kconfig
# Author: zhuxuanlin
# Email: xuanlinzhu@qq.com
# Date: 2025-6-28
# Version: 2.0.0

#####################################################
#                   标准配置，不要修改
#####################################################
mainmenu "CK TOOL CONFIG"
#配置顶层路径，这里可以修改为工程实际路径
root_path := ../..
#配置工程路径
pro_path = .

#导出变量给Cmake使用
config ROOT_PATH
    string
    default "$(root_path)"
    
config PRO_PATH
    string 
    default "$(pro_path)"

# 引入工具链管理
source "$(root_path)/tools/script/Kconfig.toolchain"

#判断是否使用实例
if(CK_EXAMPLE_DIS)
    source "$(root_path)/tools/script/Kconfig.example"
endif

#####################################################
#                   用户配置，按需修改
#####################################################
menu "project config"
    # 决定生成文件的名字
	config PRO_NAME
        string "project name"
        default "ck_project" 

    # 正式工程删除此选项
    config CK_EXAMPLE_DIS
        bool "display Kconfig example"
        default n

endmenu

#引入的外部模块配置
source "$(root_path)/package/Kconfig"
source "$(root_path)/driver/Kconfig"
```

## project/driver/drv_temp/Kconfig
```kconfig
menuconfig DRV_DRV1
    bool "drv1"
    default y

if(DRV_DRV1)

    config DRV_DRV1_NUM
        int "drv1 number"
        default 0

endif
```

## project/package/Kconfig
```kconfig
menu "package config"

source "$(pro_top_path)/package/pack_temp/Kconfig"

endmenu
```

## project/package/pack_temp/Kconfig
```kconfig
menuconfig PACK_PACK1
    bool "pack1"
    default y

if(PACK_PACK1)

    config PACK_PACK1_STR
        string "pack1 string"
        default "it's pack1"

endif
```

## project/template1/Kconfig
```kconfig
# sline top/Kconfig
mainmenu "ck_template"

# 引入其他路径的Kconfig文件
source "../../source/Kconfig"
# 创建用户程序相关的配置菜单
menu "User config"
    choice 
        prompt "choose env"
        default WIN11

        config CK_WIN7
            bool "windows7"

        config CK_WIN10
            bool "windows10"

        config CK_WIN11
            bool "windows11"
    endchoice



    config CK_STRING
        string "CK_STRING"
        default "string"
     
        
    menuconfig CK_MENUCONFIG
        bool "menuconfig example"
        default y

    if CK_MENUCONFIG

    config CK_MENUCONFIG1
        int  "CK_MENUCONFIG1"
        default 32

    config CK_MENUCONFIG2
        int  "CK_MENUCONFIG2"
        default 64

    endif
endmenu
```

## project/template3/Kconfig
```kconfig
# sline top/Kconfig
mainmenu "config"

config ROOT_PATH
    string
    default "../../"
    
config PRO_PATH
    string 
    default "./"

menu "User config"


	config PRO_NAME
        string "Input project name"
        default "lr_project" 
endmenu
```

## source/Kconfig
```kconfig
# source of Kconfig

menu "ck config"
    config CK_CONFIG
        string "ck config"
        default "config1"
    config MOD1_ENABLE
        bool "enable mod1"
        default y
    config MOD2_ENABLE
        bool "enable mod2"
        default y    
endmenu
```

## template/driver/Kconfig
```kconfig
menu "driver config"

source "$(CK_WORKSPACE_ROOT)/driver/drv_temp/Kconfig"

endmenu
```

## template/package/Kconfig
```kconfig
menu "package config"

# 自动递归子一级的Kconfig文件
source "$(CK_WORKSPACE_ROOT)/package/*/Kconfig"
# 也可以这样指定
# source "$(CK_WORKSPACE_ROOT)/package/pack_temp/Kconfig"
# source "$(CK_WORKSPACE_ROOT)/package/unity/Kconfig"
# source "$(CK_WORKSPACE_ROOT)/package/sum_mod/Kconfig"

endmenu
```

## template/package/unity/Kconfig
```kconfig
menuconfig PACK_UNITY_ENABLE
    bool "enable Unity Test"
    default n

if(PACK_UNITY_ENABLE)

config PACK_UNITY_EX_FIXTURE
    bool "Use fixture"
    default n

config PACK_UNITY_EX_MEMORY
    bool "Use memory"
    default n

endif
```

## template/project/Kconfig
```kconfig
# Author: zhuxuanlin
# Email: xuanlinzhu@qq.com
# Date: 2025-6-28
# Version: 2.0.0

#####################################################
#                   标准配置，不要修改
#####################################################
mainmenu "CK TOOLS CONFIG"
#配置ck_tools的路径
ck_tools_path := ../..
#配置工程路径
pro_top_path = ../

#导出变量给Cmake使用
config CK_TOOLS_PATH
    string
    default "$(ck_tools_path)"
    
config PRO_TOP_PATH
    string 
    default "$(pro_top_path)"

# 引入工具链管理
source "$(ck_tools_path)/ck_tools/script/Kconfig.toolchain"

#####################################################
#                   用户配置，按需修改
#####################################################
menu "project config"
    # 决定生成文件的名字
	config PRO_NAME
        string "project name"
        default "ck_project" 

    # 正式工程删除此选项
    config CK_EXAMPLE_DIS
        bool "display Kconfig example"
        default n
endmenu

#判断是否使用实例
if(CK_EXAMPLE_DIS)
    source "Kconfig.example"
endif

#引入的外部模块配置
source "$(pro_top_path)/package/Kconfig"
source "$(pro_top_path)/driver/Kconfig"
```

## template/project/standard_project/Kconfig
```kconfig
# Author: zhuxuanlin
# Email: xuanlinzhu@qq.com
# Date: 2025-6-28
# Version: 2.0.0

#####################################################
#                   CK-TOOLS工具配置
#####################################################
mainmenu "CK TOOLS CONFIG"

# CK_TOOL_CONFIG_START
# 配置ck_tools的路径
CK_TOOLS_ROOT = ../../..
# 配置工作区路径
CK_WORKSPACE_ROOT = ../..
# python ck_tools的构建命令
CK_CMD_CONFIGURE = cmake -S . -B build -G Ninja
# python ck_tools的编译命令
CK_CMD_BUILD = cmake --build build -j4
# python ck_tools的清理命令
CK_CMD_CLEAN = cmake --build build --target clean
# CK_TOOL_CONFIG_END

#导出变量给Cmake、python使用
config CK_TOOLS_ROOT
    string
    default "$(CK_TOOLS_ROOT)"
    
config CK_WORKSPACE_ROOT
    string 
    default "$(CK_WORKSPACE_ROOT)"

config CK_CMD_CONFIGURE
    string
    default "$(CK_CMD_CONFIGURE)"

config CK_CMD_BUILD
    string
    default "$(CK_CMD_BUILD)"

config CK_CMD_CLEAN
    string
    default "$(CK_CMD_CLEAN)"

# 引入工具链管理
source "$(CK_TOOLS_ROOT)/ck_tools/Kconfig.toolchain"

#####################################################
#                   用户配置，按需修改
#####################################################
menu "project config"
# 决定生成文件的名字
config PRO_NAME
    string "project name"
    default "ck_project" 

# 自动版本信息
config CK_VERSION_ENABLE
    bool "enable ck-version function"
    default n

# 是否为测试工程
config CK_TEST_UNIT
    bool "Unit test"
    default n
endmenu

# 引入的外部模块配置
source "$(CK_WORKSPACE_ROOT)/package/Kconfig"
```

## template/project/stm32_project/Kconfig
```kconfig
# Author: zhuxuanlin
# Email: xuanlinzhu@qq.com
# Date: 2026-5-26
# Version: 3.0.0

mainmenu "CK TOOLS CONFIG"
# ==================================================
# CK-TOOLS工具配置
# ==================================================
# CK_TOOL_CONFIG_START
# 配置ck_tools的路径
CK_TOOLS_ROOT = ../../..
# 配置工作区路径
CK_WORKSPACE_ROOT = ../..
# 项目类型目前支持[STANDARD STM32CUBEMX]
CK_PROJECT_TYPE = STM32CUBEMX
# python ck_tools的构建命令
CK_CMD_CONFIGURE = cmake -S . -B build -G Ninja -DCMAKE_BUILD_TYPE=Debug -DCMAKE_TOOLCHAIN_FILE=cmake/gcc-arm-none-eabi.cmake
# python ck_tools的编译命令
CK_CMD_BUILD = cmake --build build -j4
# python ck_tools的清理命令
CK_CMD_CLEAN = cmake --build build --target clean
# CK_TOOL_CONFIG_END

#导出变量给Cmake、python使用
config CK_TOOLS_ROOT
    string
    default "$(CK_TOOLS_ROOT)"
    
config CK_WORKSPACE_ROOT
    string 
    default "$(CK_WORKSPACE_ROOT)"

config CK_PROJECT_TYPE
    string 
    default "$(CK_PROJECT_TYPE)"

config CK_CMD_CONFIGURE
    string
    default "$(CK_CMD_CONFIGURE)"

config CK_CMD_BUILD
    string
    default "$(CK_CMD_BUILD)"

config CK_CMD_CLEAN
    string
    default "$(CK_CMD_CLEAN)"

# 引入工具链管理,STM32项目默认使用cubeMX生成的工具链配置
if CK_PROJECT_TYPE = "STANDARD"
source "$(CK_TOOLS_ROOT)/ck_tools/Kconfig.toolchain"
endif

# ==================================================
# 用户配置
# ==================================================
menu "project config"
# 决定生成文件的名字
config PRO_NAME
    string "project name"
    default "ck_project" 

# 自动版本信息
config CK_VERSION_ENABLE
    bool "enable ck-version function"
    default n
    
# 是否启用单元测试功能
config CK_TEST_UNIT
    bool "enable test unit function"
    default n
endmenu

# ==================================================
# 用户配置 按需求增加,写在注释内 才能被自动扫描
# ==================================================
# 引入的外部模块配置
# CK_TOOL_EXTERNAL_START
source "$(CK_WORKSPACE_ROOT)/package/Kconfig"

# CK_TOOL_EXTERNAL_END
```

## template/test/template/Kconfig
```kconfig
# Author: zhuxuanlin
# Email: xuanlinzhu@qq.com
# Date: 2025-6-28
# Version: 2.0.0

#####################################################
#                   标准配置，不要修改
#####################################################
# Author: zhuxuanlin
# Email: xuanlinzhu@qq.com
# Date: 2025-6-28
# Version: 2.0.0

#####################################################
#                   标准配置，不要修改
#####################################################
mainmenu "CK TOOLS CONFIG"

# CK_TOOL_CONFIG_START
# 配置ck_tools的路径
CK_TOOLS_ROOT = ../../..
# 配置工作区路径
CK_WORKSPACE_ROOT = ../..
# python ck_tools的构建命令
CK_CMD_CONFIGURE = cmake -S . -B build -G Ninja
# python ck_tools的编译命令
CK_CMD_BUILD = cmake --build build -j4
# python ck_tools的清理命令
CK_CMD_CLEAN = cmake --build build --target clean
# CK_TOOL_CONFIG_END

#导出变量给Cmake、python使用
config CK_TOOLS_ROOT
    string
    default "$(CK_TOOLS_ROOT)"
    
config CK_WORKSPACE_ROOT
    string 
    default "$(CK_WORKSPACE_ROOT)"

config CK_CMD_CONFIGURE
    string
    default "$(CK_CMD_CONFIGURE)"

config CK_CMD_BUILD
    string
    default "$(CK_CMD_BUILD)"

config CK_CMD_CLEAN
    string
    default "$(CK_CMD_CLEAN)"

# 引入工具链管理
source "$(CK_TOOLS_ROOT)/ck_tools/Kconfig.toolchain"

#####################################################
#                   用户配置，按需修改
#####################################################
menu "project config"
# 决定生成文件的名字
config PRO_NAME
    string "project name"
    default "uinit_test"

# 版本开关
config CK_VERSION_ENABLE
    bool "enable ck-version function"
    default n

# 测试类型选择
choice
prompt "Select test type"
default PRO_TEST_UNIT

config PRO_TEST_UNIT
    bool "Unit test"

config PRO_TEST_INTEGRATION
    bool "Integration test"

config PRO_TEST_NONE
    bool "None"
endchoice
endmenu

#引入的外部模块配置
source "$(CK_WORKSPACE_ROOT)/driver/Kconfig"
source "$(CK_WORKSPACE_ROOT)/package/Kconfig"
```

## tools/script/Kconfig.example
```kconfig
# Author: zhuxuanlin
# Email: xuanlinzhu@qq.com
# Date: 2025-6-28
# Version: 2.0.0

# 顶层菜单配置文件示例
menu "example config"

# 1. 布尔类型（bool）
config FEATURE_A
    bool "Enable Feature A"
    default y
    help
        This enables Feature A, which is a basic example of a bool.

# 2. 三态（tristate）：可选 y/m/n
config MODULE_X
    tristate "Enable module X"
    default m
    help
        Tri-state option: yes, module, or no.

# 3. 整数类型（int）
config FEATURE_INT
    int "Feature integer value"
    default 10
    range 0 100
    help
        Set an integer between 0 and 100.

# 4. 字符串类型（string）
config FEATURE_STR
    string "Custom string value"
    default "default_value"
    help
        Set your custom string value here.

# 5. 依赖关系（depends on）
config FEATURE_B
    bool "Feature B"
    depends on FEATURE_A
    default y
    help
        Enabled only if FEATURE_A is enabled.

# 6. 选择（select）
config FEATURE_C
    bool "Feature C (selects FEATURE_A)"
    select FEATURE_A
    help
        When enabled, it automatically enables FEATURE_A.

# 7. 条件表达式（if ... endif）
if FEATURE_A
config FEATURE_A_EXTRA
    bool "Extra option under A"
    default y
endif

# 8. choice 块（互斥选项）
choice
    prompt "Choose a backend"
    default BACKEND_SPI

config BACKEND_SPI
    bool "SPI Backend"

config BACKEND_I2C
    bool "I2C Backend"

config BACKEND_UART
    bool "UART Backend"

endchoice

# 9. menuconfig（带子菜单）
menuconfig ADVANCED_FEATURE
    bool "Enable advanced features"
    default n

if ADVANCED_FEATURE
config ADV_SUBOPT1
    bool "Advanced Sub Feature 1"
    default y

config ADV_SUBOPT2
    bool "Advanced Sub Feature 2"
    default n
endif

# 10. 可见性控制（visible if）
config HIDDEN_OPTION
    bool "Hidden unless Feature A is on"
    depends on FEATURE_A
    default y

endmenu
```

## tools/script/Kconfig.toolchain
```kconfig
menu "toolchain config"




# 设置目标系统类型
choice
    prompt "Target System Type"
    default TC_SYSTEM_NAME_GENERIC

config TC_SYSTEM_NAME_GENERIC
    bool "Generic"
    help
      Generic system, no specific OS.

config TC_SYSTEM_NAME_WINDOWS
    bool "Windows"
    help
      Microsoft Windows OS.

config TC_SYSTEM_NAME_LINUX
    bool "Linux"
    help
      Target system is Linux.

config TC_SYSTEM_NAME_DARWIN
    bool "Darwin (macOS)"
    help
      Apple macOS system.

endchoice


# 设置目标架构
choice
    prompt "Target CPU Architecture"
    default TC_CPU_X86_64

config TC_CPU_X86_64
    bool "x86_64"
    help
      64-bit Intel/AMD architecture.

config TC_CPU_ARM
    bool "arm"
    help
      ARM 32-bit architecture.

config TC_CPU_AARCH64
    bool "aarch64"
    help
      ARM 64-bit architecture.

config TC_CPU_MIPS
    bool "mips"
    help
      MIPS architecture.

config TC_CPU_RISCV64
    bool "riscv64"
    help
      RISC-V 64-bit architecture.

endchoice

# 编译类型
choice
    prompt "Build Type"
    default TC_BUILD_TYPE_DEBUG

config TC_BUILD_TYPE_DEBUG
    bool "Debug"
    help
      Debug build with debug symbols and no optimization.

config TC_BUILD_TYPE_RELEASE
    bool "Release"
    help
      Release build with optimizations enabled.

config TC_BUILD_TYPE_RELWITHDEBINFO
    bool "RelWithDebInfo"
    help
      Release build with debug info included.

config TC_BUILD_TYPE_MINSIZEREL
    bool "MinSizeRel"
    help
      Release build optimized for minimum size.

endchoice

# 是否交叉编译
config TC_CROSSCOMPILING
    bool "Enable Cross Compiling"
    default n
    help
      Enable this option if you are performing cross-compilation.
      When enabled, CMake will treat the build as cross-compiling.

config TC_C_STANDARD
    string "C Language Standard"
    default "c11"
    help
      Specify the C language standard version, e.g., 99, 11, 17.

config TC_CXX_STANDARD
    string "C++ Language Standard"
    default "c++11"
    help
      Specify the C++ language standard version, e.g., 11, 14, 17.

# 设置编译器路径
config TC_C_CXX_COMPILER
    string "C/C++ Compiler"
    default ""
    help
      Specify the full path or command name of the C/C++ compiler to use for cross-compilation.


# 设置编译参数
config TC_COMPILE_OPTIONS
    string "compile options"
    default ""
    help
      Additional flags to pass to the compiler.

# 设置链接参数
config TC_LINK_OPTIONS
    string "link options"
    default ""
    help
      Additional flags to pass to the linker.

# 设置lds文件
config TC_LINK_FILE
    string "link file(lds)"
    default ""
    help
      Additional link file(current path) to the project.

config TC_GENERATE_BIN
    bool "Generate Binary File"
    default n
    help
      Enable generation of binary (.bin) file from the executable.

config TC_GENERATE_DISASSEMBLY
    bool "Generate Disassembly File"
    default n
    help
      Enable generation of disassembly (.dis) file for the executable.

config TC_GENERATE_MAP_FILE
    bool "Generate Map File"
    default n
    help
      Enable generation of a map file during linking for debugging and analysis.

endmenu
```
